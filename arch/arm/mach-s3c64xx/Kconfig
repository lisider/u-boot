## arch/arm/mach-s3c64xx/Kconfig
```kconfig
if ARCH_S3C64XX 

config TARGET_OK6410A
	default y
	bool "Support ok6410a board"
	select OF_CONTROL
	select SUPPORT_SPL

config S3C64XX
	default y
	bool "Support S3C64XX platform feature"

source "board/samsung/ok6410a/Kconfig"

endif
```

## board/samsung/ok6410a/Kconfig
```kconfig
if TARGET_OK6410A

config SYS_BOARD
	default "ok6410a"

config SYS_VENDOR
	default "samsung"

config SYS_SOC
	default "s3c64xx"

config SYS_CONFIG_NAME
	default "ok6410a"

endif
```

## configs/ok6410a_defconfig
```kconfig
CONFIG_ARM=y
CONFIG_ARCH_S3C64XX=y
CONFIG_SYS_TEXT_BASE=0x5FB00000
CONFIG_TARGET_OK6410A=y
CONFIG_LOGLEVEL=7
CONFIG_IDENT_STRING=" for OK6410A"
CONFIG_NR_DRAM_BANKS=1

#
# CONFIG_ENV_IS_IN_XXX only one can be set
#
CONFIG_ENV_IS_IN_MMC=y 
#CONFIG_ENV_IS_IN_NAND=y

CONFIG_SPL_MMC_BOOT=y
CONFIG_SPL_NAND_BOOT=y

CONFIG_SPL_LDSCRIPT="board/$(BOARDDIR)/u-boot-spl.lds"
CONFIG_SPL_BOARD_INIT=y
CONFIG_BOOTDELAY=1
CONFIG_USE_BOOTARGS=y
# CONFIG_BOOTARGS="root=/dev/mtdblock5 ubi.mtd=4 rootfstype=cramfs console=ttySAC0,115200n8 mem=128M  mtdparts=s3c-onenand:256k(bootloader),128k@0x40000(params),3m@0x60000(kernel),16m@0x360000(test),-(UBI)"
CONFIG_BOOTARGS="root=/dev/mtdblock2 rootfstype=cramfs console=ttySAC0,115200"

CONFIG_HUSH_PARSER=y
CONFIG_SYS_PROMPT_HUSH_PS2="> "
# CONFIG_AUTO_COMPLETE is not set
CONFIG_SYS_PROMPT="OK6410 # "
CONFIG_CMD_FLASH=y
CONFIG_CMD_MMC=y
# CONFIG_CMD_ONENAND is not set
# CONFIG_CMD_SETEXPR is not set
CONFIG_CMD_CACHE=y
CONFIG_CMD_FAT=y
CONFIG_CMD_MTDPARTS=y
CONFIG_MTDIDS_DEFAULT="onenand0=s3c-onenand"
CONFIG_MTDPARTS_DEFAULT="mtdparts=s3c-onenand:256k(bootloader),128k@0x40000(params),3m@0x60000(kernel),16m@0x360000(test),-(UBI)"
CONFIG_DEFAULT_DEVICE_TREE="s3c64xx-ok6410a"

CONFIG_BOARD_EARLY_INIT_F=y
#
# clk Device support
# CONFIG_SPL_CLK is not set
CONFIG_CLK=y

#
# lcd support
# CONFIG_LCD is not set
# CONFIG_SYS_WHITE_ON_BLACK is not set
# CONFIG_LCD_S3CFB is not set
# CONFIG_S3C_LCD_LOGO is not set
# CONFIG_CONSOLE_SCROLL_LINES is not set

#
#
CONFIG_SPL_GPIO_SUPPORT=y

#
# support MMC boot
CONFIG_MMC=y
CONFIG_DM_MMC=y
CONFIG_MMC_SDHCI=y
# CONFIG_MMC_SDHCI_SDMA is not set
CONFIG_MMC_SDHCI_S3C64XX=y

# CONFIG_SPL_DM is not set
# CONFIG_SPL_DM_MMC is not set
# CONFIG_SPL_MMC_SUPPORT=y

CONFIG_MTD_DEVICE=y
CONFIG_MTD_PARTITIONS=y
CONFIG_NAND=y
CONFIG_NAND_S3C64XX=y

# CONFIG_USB is not set
# CONFIG_DM_USB is not set
# CONFIG_CMD_USB_DNW is not set
# CONFIG_USB_S3C64XX is not set
# CONFIG_CMD_USB is not set

#
# USB Host Controller Drivers
#
# CONFIG_USB_HOST is not set
# CONFIG_USB_XHCI_HCD is not set
# CONFIG_USB_OHCI_HCD is not set

#
# uart early debug
#
# CONFIG_DEBUG_UART is not set
# CONFIG_DEBUG_UART_S3C is not set
CONFIG_DEBUG_UART_BASE=0x7F005000
CONFIG_DEBUG_UART_CLOCK=66000000
CONFIG_DEBUG_UART_SHIFT=0

CONFIG_SPL=y
# SPL debug 
CONFIG_SPL_SERIAL_SUPPORT=y

# support printf()
CONFIG_SPL_LIBCOMMON_SUPPORT=y 
CONFIG_SPL_LIBGENERIC_SUPPORT=y
CONFIG_SPL_PRINTF=y
CONFIG_USE_TINY_PRINTF=y

# pool size,using before relocation
CONFIG_SYS_MALLOC_F_LEN=0x100000

# size for malloc pool, should be under part of CFG_UBOOT_SIZE
CONFIG_SYS_MALLOC_LEN=0x100000
CONFIG_SHOW_BOOT_PROGRESS=y


CONFIG_ENV_OFFSET=0x80000

CONFIG_SPL_TEXT_BASE=0x0C000000
CONFIG_ENV_SIZE=0x4000
```

## configs/ok6410a_mini_defconfig
```kconfig
# target
CONFIG_ARM=y
CONFIG_ARCH_S3C64XX=y
CONFIG_TARGET_OK6410A=y

# driver
CONFIG_NR_DRAM_BANKS=1
CONFIG_CLK=y
CONFIG_MMC=y
CONFIG_MMC_SDHCI=y
CONFIG_MMC_SDHCI_S3C64XX=y
CONFIG_NET_RANDOM_ETHADDR=y

# mem
CONFIG_SYS_MALLOC_F_LEN=0x100000
CONFIG_SYS_TEXT_BASE=0x5FB00000
CONFIG_SPL_TEXT_BASE=0x0C000000

#env
CONFIG_ENV_IS_IN_MMC=y
CONFIG_ENV_OFFSET=0x80000
CONFIG_ENV_SIZE=0x4000

# cmdline
CONFIG_CMD_FAT=y
CONFIG_DEFAULT_DEVICE_TREE="s3c64xx-ok6410a"

# spl
CONFIG_SPL=y
CONFIG_SPL_LDSCRIPT="board/$(BOARDDIR)/u-boot-spl.lds"
CONFIG_SPL_SERIAL_SUPPORT=y
CONFIG_SPL_LIBGENERIC_SUPPORT=y
```
